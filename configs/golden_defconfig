## configs/golden_defconfig
```kconfig
CONFIG_POSITION_INDEPENDENT=n
CONFIG_RAMDISK_NO_COPY=y
CONFIG_LINUX_KRNL_HEADER_IMG=n
CONFIG_ST8500=y
CONFIG_SAMSUNG_GOLDEN=y
CONFIG_TEXT_BASE=0x100000
CONFIG_RAMDISK_ENTRY=0x02000000
CONFIG_PAYLOAD_ENTRY=0x18100800
```
